## sdkconfig.defaults
```kconfig
# Default project configuration for the Communicator badge (ESP32-S3 N16R8).
# Override per-developer in sdkconfig (generated, gitignored).

CONFIG_IDF_TARGET="esp32s3"

# --- Flash (16 MB) + custom partition table -------------------------------
CONFIG_ESPTOOLPY_FLASHSIZE_16MB=y
CONFIG_ESPTOOLPY_FLASHMODE_QIO=y
CONFIG_ESPTOOLPY_FLASHFREQ_80M=y
CONFIG_PARTITION_TABLE_CUSTOM=y
CONFIG_PARTITION_TABLE_CUSTOM_FILENAME="partitions.csv"
# Dual-OTA layout with bootloader rollback: a freshly OTA'd image must call
# esp_ota_mark_app_valid_cancel_rollback() (see ota_mark_valid in app_main),
# otherwise the bootloader reverts to the previous slot on the next reset.
CONFIG_BOOTLOADER_APP_ROLLBACK_ENABLE=y

# --- PSRAM (octal, N16R8) -------------------------------------------------
CONFIG_SPIRAM=y
CONFIG_SPIRAM_MODE_OCT=y
CONFIG_SPIRAM_SPEED_80M=y
CONFIG_SPIRAM_USE_MALLOC=y
CONFIG_SPIRAM_TRY_ALLOCATE_WIFI_LWIP=y

# --- CPU + power management (light sleep / DFS) ---------------------------
CONFIG_ESP_DEFAULT_CPU_FREQ_MHZ_240=y
CONFIG_PM_ENABLE=y
CONFIG_PM_DFS_INIT_AUTO=y
CONFIG_FREERTOS_USE_TICKLESS_IDLE=y
CONFIG_PM_SLP_IRAM_OPT=y

# --- LVGL 9 (managed component lvgl/lvgl) ---------------------------------
CONFIG_LV_COLOR_DEPTH_16=y
CONFIG_LV_MEM_SIZE_KILOBYTES=64
CONFIG_LV_USE_PERF_MONITOR=n
# Dark default theme: light widget text, so labels without an explicit colour
# are readable on the dark background.
CONFIG_LV_THEME_DEFAULT_DARK=y
CONFIG_LV_FONT_MONTSERRAT_14=y
CONFIG_LV_FONT_MONTSERRAT_18=y
CONFIG_LV_FONT_DEFAULT_MONTSERRAT_14=y
# NV3007 panel driver: LVGL 9.5 doesn't expose it via Kconfig, so it's enabled
# build-wide with -DCONFIG_LV_USE_NV3007=1 in the top-level CMakeLists.txt
# (which also pulls in the generic-MIPI driver it depends on).

# --- Bluetooth (NimBLE, for the Meshtastic companion; runtime-gated) -------
CONFIG_BT_ENABLED=y
CONFIG_BT_NIMBLE_ENABLED=y

# --- Misc -----------------------------------------------------------------
CONFIG_COMPILER_OPTIMIZATION_PERF=y
CONFIG_ESP_MAIN_TASK_STACK_SIZE=6144
CONFIG_FREERTOS_HZ=1000
```
